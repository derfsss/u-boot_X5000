## board/varisys/cyrus/Kconfig
```kconfig
if TARGET_CYRUS_P5020 || TARGET_CYRUS_P5040

config SYS_BOARD
	default "cyrus"

config SYS_VENDOR
	default "varisys"

config SYS_CONFIG_NAME
	default "cyrus"

# AmigaOne X5000: developer DDR-diagnostic options, used only by the
# Cyrus_P5020_SDCARD_DDRDIAG*_defconfig builds. Normal firmware leaves them off.
config CYRUS_DDR_DIAG
	bool "SPL DDR diagnostics"
	depends on SPL
	help
	  Print DDR diagnostics from the SPL on the serial console: RCW and
	  reset status, clocks, the full SPD contents of each DIMM, the
	  computed timings, every DDR controller register, the D_INIT memory
	  fill result, a DRAM pattern test reporting errors per byte lane,
	  and a check that the U-Boot copy reads back identically; if it
	  does not, the SPL stops instead of starting a corrupted U-Boot.
	  Adds a few seconds to every boot. A developer tool for
	  fault-finding DDR problems; not for normal firmware images.

config CYRUS_DDR_DIAG_RELAXED
	bool "Relaxed DDR timings for diagnosis"
	depends on CYRUS_DDR_DIAG
	help
	  Run DDR with 2T command timing and CAS latency 10 instead of the
	  SPD-derived values, at the unchanged data rate. A board that
	  passes the DDR diagnostics only with this set has a marginal
	  signal path rather than a dead one.

config CYRUS_DDR_DIAG_SWEEP
	bool "Boot-to-boot DDR timing sweep for diagnosis"
	depends on CYRUS_DDR_DIAG
	select SPL_MMC_WRITE
	help
	  Each power-on applies one DDR write-levelling setting at the
	  normal DDR init, then runs the DDR diagnostics: every byte lane
	  at the same start, 0x02..0x14 in quarter-clock steps, mapping each
	  lane's working window (apply the result with the ddr_wrlvlN
	  environment variable, see board/varisys/cyrus/ddr.c). A step counter
	  in SD sector 0x3FF0 (offset 0x7FE000) advances on every boot;
	  reflashing the image restarts the sweep. Writes one SD sector per
	  boot. For fault-finding only.

source "board/freescale/common/Kconfig"

endif
```

## configs/Cyrus_P5040_SDCARD_PRODUCTION_defconfig
```kconfig
CONFIG_PPC=y
CONFIG_SYS_TEXT_BASE=0x30001000
CONFIG_SPL_LIBCOMMON_SUPPORT=y
CONFIG_SPL_LIBGENERIC_SUPPORT=y
CONFIG_ENV_SIZE=0x2000
CONFIG_ENV_OFFSET=0x150000
CONFIG_SPL_TEXT_BASE=0xFFFD8000
CONFIG_SPL_MMC_SUPPORT=y
CONFIG_SPL_SERIAL_SUPPORT=y
CONFIG_SPL_DRIVERS_MISC_SUPPORT=y
CONFIG_SPL=y
CONFIG_MPC85xx=y
CONFIG_TARGET_CYRUS_P5040=y
# CONFIG_CC_OPTIMIZE_FOR_SIZE is not set
CONFIG_FIT=y
CONFIG_FIT_VERBOSE=y
CONFIG_OF_BOARD_SETUP=y
CONFIG_SYS_EXTRA_OPTIONS="RAMBOOT_PBL,SDCARD"
CONFIG_BOOTDELAY=3
CONFIG_CONSOLE_MUX=y
CONFIG_BOARD_EARLY_INIT_F=y
CONFIG_BOARD_EARLY_INIT_R=y
# CONFIG_SPL_FRAMEWORK is not set
CONFIG_SPL_MMC_BOOT=y
CONFIG_SPL_FSL_PBL=y
CONFIG_SPL_ENV_SUPPORT=y
CONFIG_SPL_I2C_SUPPORT=y
CONFIG_SPL_MPC8XXX_INIT_DDR_SUPPORT=y
CONFIG_HUSH_PARSER=y
CONFIG_CMD_GREPENV=y
CONFIG_CMD_I2C=y
CONFIG_CMD_MMC=y
CONFIG_CMD_USB=y
CONFIG_CMD_SATA=y
CONFIG_CMD_BOOTA=y
CONFIG_BOOTA_PRODUCTION=y
CONFIG_CMD_FWUPDATE=y
CONFIG_CMD_SHUTDOWN=y
CONFIG_FSL_SATA=y
CONFIG_BIOSEMU=y
CONFIG_VIDEO=y
CONFIG_CFB_CONSOLE_ANSI=y
CONFIG_SYS_CONSOLE_BG_COL=0xff
CONFIG_SYS_CONSOLE_FG_COL=0x00
CONFIG_CMD_BMP=y
CONFIG_SILENT_CONSOLE=y
CONFIG_CMD_DHCP=y
CONFIG_CMD_PING=y
CONFIG_CMD_DATE=y
CONFIG_MP=y
# CONFIG_CMD_HASH is not set
CONFIG_CMD_EXT2=y
CONFIG_CMD_FAT=y
CONFIG_CMD_FS_GENERIC=y
CONFIG_CMD_PART=y
CONFIG_FS_SFS=y
CONFIG_FS_AFFS=y
CONFIG_FS_NGFS=y
CONFIG_FS_EXFAT=y
CONFIG_AMIGA_PARTITION=y
CONFIG_ENV_OVERWRITE=y
CONFIG_ENV_IS_IN_MMC=y
CONFIG_SYS_RELOC_GD_ENV_ADDR=y
CONFIG_FSL_ESDHC=y
CONFIG_PHYLIB=y
CONFIG_PHY_MICREL=y
CONFIG_PHY_MICREL_KSZ90X1=y
CONFIG_E1000=y
CONFIG_FMAN_ENET=y
CONFIG_MII=y
CONFIG_SYS_QE_FMAN_FW_IN_MMC=y
CONFIG_SYS_NS16550=y
CONFIG_SPI=y
CONFIG_FSL_ESPI=y
CONFIG_USB=y
CONFIG_USB_STORAGE=y
CONFIG_USB_KEYBOARD=y
CONFIG_USB_EHCI_HCD=y
CONFIG_USB_EHCI_FSL=y
CONFIG_SYS_USB_EVENT_POLL_VIA_INT_QUEUE=y
CONFIG_USE_PREBOOT=y
CONFIG_PREBOOT="usb start"
CONFIG_ADDR_MAP=y
CONFIG_SYS_NUM_ADDR_MAP=64
CONFIG_OF_LIBFDT=y
# CONFIG_CMD_NFS is not set
# CONFIG_REGEX is not set
# CONFIG_CMD_ELF is not set
# CONFIG_CMD_EDITENV is not set
```

## fs/Kconfig
```kconfig
#
# File system configuration
#

menu "File systems"

source "fs/btrfs/Kconfig"

source "fs/cbfs/Kconfig"

source "fs/ext4/Kconfig"

source "fs/reiserfs/Kconfig"

source "fs/fat/Kconfig"

source "fs/jffs2/Kconfig"

source "fs/ubifs/Kconfig"

source "fs/cramfs/Kconfig"

source "fs/yaffs2/Kconfig"

source "fs/squashfs/Kconfig"

# AmigaOne: AmigaOS filesystems (SFS, FFS/OFS, NGFS) and exFAT, all read-only
source "fs/sfs/Kconfig"

source "fs/affs/Kconfig"

source "fs/ngfs/Kconfig"

source "fs/exfat/Kconfig"

endmenu
```

## fs/affs/Kconfig
```kconfig
# SPDX-License-Identifier: GPL-2.0+

config FS_AFFS
	bool "Amiga FFS/OFS (FastFileSystem) support"
	help
	  This provides a read-only driver for the Amiga FastFileSystem (FFS)
	  and OldFileSystem (OFS), as used on AmigaOS / AmigaOne RDB (Rigid
	  Disk Block) partitions (DOS\0 through DOS\7, including the
	  international, dir-cache and long-name variants).  It plugs into
	  U-Boot's generic filesystem framework, so the fstype, ls, load and
	  size commands work on FFS/OFS partitions.
```

## fs/exfat/Kconfig
```kconfig
config FS_EXFAT
	bool "Enable EXFAT filesystem support"
	imply CMD_FS_GENERIC if CMDLINE
	help
	  This provides exFAT support. AmigaOne: backported from mainline
	  U-Boot (commit b0da72e) and registered read-only (fs/fs.c), so
	  the write code is not linked.
```

## fs/ngfs/Kconfig
```kconfig
# SPDX-License-Identifier: GPL-2.0+

config FS_NGFS
	bool "Amiga New Generation File System (NGFS) support"
	help
	  This provides a read-only driver for the Amiga "New Generation File
	  System" (NGFS), the 64-bit AmigaOS 4 filesystem (RDB DosType NGF\x).
	  It is written from the on-disk format description in
	  docs/ngfs-format.md and is unrelated to the SFS driver.  It plugs
	  into U-Boot's generic filesystem framework, so the fstype, ls, load
	  and size commands work on NGFS partitions.  Only NGF\1 volumes have
	  been tested; NGF\0 support is untested.
```

## fs/sfs/Kconfig
```kconfig
# SPDX-License-Identifier: GPL-2.0+

config FS_SFS
	bool "Amiga SmartFileSystem (SFS) filesystem support"
	help
	  This provides a read-only driver for the Amiga SmartFileSystem
	  (SFS), as used on AmigaOS / AmigaOne RDB (Rigid Disk Block)
	  partitions.  It plugs into U-Boot's generic filesystem framework,
	  so the fstype, ls, load and size commands work on SFS partitions.
```
